## forwarding_zephyr_node/build/Kconfig/arch/Kconfig
```kconfig
# Load Zephyr Arch Kconfig descriptions.
osource "C:/Users/Hunter/zephyrproject/zephyr/arch/rx/Kconfig"
osource "C:/Users/Hunter/zephyrproject/zephyr/arch/x86/Kconfig"
osource "C:/Users/Hunter/zephyrproject/zephyr/arch/xtensa/Kconfig"
osource "C:/Users/Hunter/zephyrproject/zephyr/arch/sparc/Kconfig"
osource "C:/Users/Hunter/zephyrproject/zephyr/arch/riscv/Kconfig"
osource "C:/Users/Hunter/zephyrproject/zephyr/arch/posix/Kconfig"
osource "C:/Users/Hunter/zephyrproject/zephyr/arch/openrisc/Kconfig"
osource "C:/Users/Hunter/zephyrproject/zephyr/arch/mips/Kconfig"
osource "C:/Users/Hunter/zephyrproject/zephyr/arch/arm64/Kconfig"
osource "C:/Users/Hunter/zephyrproject/zephyr/arch/arm/Kconfig"
osource "C:/Users/Hunter/zephyrproject/zephyr/arch/arc/Kconfig"
```

## forwarding_zephyr_node/build/Kconfig/boards/Kconfig.defconfig.tmp
```kconfig
# Load Zephyr board defconfig descriptions.
osource "C:/Users/Hunter/zephyrproject/zephyr/boards/st/nucleo_f439zi/Kconfig.defconfig"
```

## forwarding_zephyr_node/build/Kconfig/boards/Kconfig.sysbuild.tmp
```kconfig
# Load Sysbuild board Kconfig descriptions.
osource "C:/Users/Hunter/zephyrproject/zephyr/boards/st/nucleo_f439zi/Kconfig.sysbuild"
```

## measuring_zephyr_node/build/Kconfig/boards/Kconfig.nucleo_f439zi
```kconfig
# Load board Kconfig descriptions.
osource "C:/Users/Hunter/zephyrproject/zephyr/boards/st/nucleo_f439zi/Kconfig.nucleo_f439zi"
```

## measuring_zephyr_node/build/Kconfig/boards/Kconfig.tmp
```kconfig
# Load Zephyr board Kconfig descriptions.
osource "C:/Users/Hunter/zephyrproject/zephyr/boards/st/nucleo_f439zi/Kconfig"
```
